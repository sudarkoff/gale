## main/Kconfig.projbuild
```kconfig
menu "Gale Configuration"

    config DEBUG_MODE
        bool "Enable debug mode"
        default n
        help
            Enable debug mode with shorter fan delays and no hysteresis.

    config DEFAULT_WIFI_SSID
        string "Default WiFi SSID"
        default ""
        help
            Default WiFi SSID to connect to in station mode.
            Leave empty to start in AP mode.

    config DEFAULT_WIFI_PASSWORD
        string "Default WiFi Password"
        default ""
        help
            Default WiFi password for station mode.

    config DEFAULT_AP_SSID
        string "Default AP SSID"
        default "Gale"
        help
            SSID for Access Point mode.

    config DEFAULT_AP_PASSWORD
        string "Default AP Password"
        default "gale1234"
        help
            Password for Access Point mode. Minimum 8 characters.

    config DEFAULT_HR_MAX
        int "Default Maximum Heart Rate"
        range 100 250
        default 200
        help
            Default maximum heart rate in BPM.

    config DEFAULT_HR_RESTING
        int "Default Resting Heart Rate"
        range 30 100
        default 50
        help
            Default resting heart rate in BPM.

    config RELAY_GPIO_1
        int "Relay 1 GPIO Pin"
        range 0 39
        default 25
        help
            GPIO pin for relay 1 (fan speed 1).

    config RELAY_GPIO_2
        int "Relay 2 GPIO Pin"
        range 0 39
        default 26
        help
            GPIO pin for relay 2 (fan speed 2).

    config RELAY_GPIO_3
        int "Relay 3 GPIO Pin"
        range 0 39
        default 27
        help
            GPIO pin for relay 3 (fan speed 3).

    config STATUS_LED_GPIO
        int "Status LED GPIO Pin"
        range 0 39
        default 2
        help
            GPIO pin for status LED (indicates BLE connection).

endmenu
```

## sdkconfig.defaults
```kconfig
# Partition Table
CONFIG_PARTITION_TABLE_CUSTOM=y
CONFIG_PARTITION_TABLE_CUSTOM_FILENAME="partitions.csv"
CONFIG_PARTITION_TABLE_FILENAME="partitions.csv"

# WiFi Configuration (Required for Matter over WiFi)
CONFIG_ESP_WIFI_ENABLED=y
CONFIG_ESP_WIFI_STATIC_RX_BUFFER_NUM=10
CONFIG_ESP_WIFI_DYNAMIC_RX_BUFFER_NUM=32
CONFIG_ESP_WIFI_DYNAMIC_TX_BUFFER_NUM=32

# Bluetooth Configuration (NimBLE for Matter + BLE Central for HRM)
CONFIG_BT_ENABLED=y
CONFIG_BT_NIMBLE_ENABLED=y
CONFIG_BT_NIMBLE_ROLE_CENTRAL=y
CONFIG_BT_NIMBLE_ROLE_PERIPHERAL=y
CONFIG_BT_NIMBLE_ROLE_OBSERVER=y
CONFIG_BT_NIMBLE_ROLE_BROADCASTER=y
CONFIG_BT_NIMBLE_MAX_CONNECTIONS=2

# Keep BLE active after commissioning for HRM connection
CONFIG_USE_BLE_ONLY_FOR_COMMISSIONING=n

# Matter/CHIP Configuration
CONFIG_CHIP_PROJECT_CONFIG="main/CHIPProjectConfig.h"
CONFIG_ENABLE_CHIP_SHELL=y

# Commissioning options - use test mode for development
CONFIG_ENABLE_TEST_SETUP_PARAMS=y

# Factory data provider (for production, set to y and use esp-matter-mfg-tool)
CONFIG_ENABLE_ESP32_FACTORY_DATA_PROVIDER=n
CONFIG_ENABLE_ESP32_DEVICE_INSTANCE_INFO_PROVIDER=n

# FreeRTOS
CONFIG_FREERTOS_HZ=1000
CONFIG_FREERTOS_ENABLE_BACKWARD_COMPATIBILITY=y

# Main task stack size (Matter requires larger stack)
CONFIG_ESP_MAIN_TASK_STACK_SIZE=8192

# LWIP Configuration (Required for Matter networking)
CONFIG_LWIP_IPV6=y
CONFIG_LWIP_IPV6_AUTOCONFIG=y

# mDNS Configuration (Required for Matter discovery)
CONFIG_MDNS_MULTIPLE_INSTANCE=y

# NVS
CONFIG_NVS_ENCRYPTION=n

# mbedTLS Configuration (Required for Matter crypto)
CONFIG_MBEDTLS_HKDF_C=y
```
